## Kconfig
```kconfig
#
# Copyright (c) 2022 Laird Connectivity LLC
#
# SPDX-License-Identifier: LicenseRef-LairdConnectivity-Clause
#
menuconfig LCZ_SHELL_SCRIPT_RUNNER
	bool "LCZ Shell Script Runner"
	depends on SHELL_BACKEND_DUMMY
	depends on FILE_SYSTEM

if LCZ_SHELL_SCRIPT_RUNNER

module=LCZ_SHELL_SCRIPT_RUNNER
module-str=LCZ_SHELL_SCRIPT_RUNNER
source "subsys/logging/Kconfig.template.log_config"

config LCZ_ZSH_PATH_MAX_SIZE
	int "Path max size"
	default 32
	help
	  Maximum length of the script file path.

config LCZ_ZSH_CMD_MAX_SIZE
	int "Max command size"
	default 128
	help
	  This value should be less than or equal to
	  CONFIG_SHELL_CMD_BUFF_SIZE. This value is used for a buffer size
	  to read in commands from a file.
	  This buffer is allocated on the stack.

endif # LCZ_SHELL_SCRIPT_RUNNER
```
